## sdkconfig.defaults
```kconfig
CONFIG_BT_ENABLED=y
CONFIG_BT_NIMBLE_ENABLED=y
CONFIG_BT_NIMBLE_NVS_PERSIST=y
CONFIG_BT_BLUEDROID_ENABLED=n
CONFIG_BT_CLASSIC_ENABLED=n
CONFIG_BT_BLE_ENABLED=n
CONFIG_BT_NIMBLE_HID_SERVICE=y
CONFIG_PARTITION_TABLE_SINGLE_APP_LARGE=y
```
